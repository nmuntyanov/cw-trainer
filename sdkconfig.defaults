## sdkconfig.defaults
```kconfig
# HTTP Server
CONFIG_HTTPD_WS_SUPPORT=y

# Flash size 
CONFIG_ESPTOOLPY_FLASHSIZE_4MB=y
# CONFIG_ESPTOOLPY_FLASHSIZE_2MB is not set
CONFIG_ESPTOOLPY_FLASHSIZE="4MB"

# Common settings
CONFIG_ESP_SYSTEM_EVENT_QUEUE_SIZE=32
CONFIG_ESP_MAIN_TASK_STACK_SIZE=4096
```
